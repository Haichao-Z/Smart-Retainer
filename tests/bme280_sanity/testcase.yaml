## tests/bme280_sanity/testcase.yaml
```yaml
tests:
  ese5180.bme280.sanity_check:
    platform_allow:
      - nrf7002dk_nrf5340_cpuapp
    tags: sensor bme280
    harness: ztest
```

## tests/test_LED/testcase.yaml
```yaml
tests:
  ese5180.led_switch.ztest:
    platform_allow:
      - nrf7002dk_nrf5340_cpuapp_ns
    tags: led
    harness: ztest
```

## tests/test_basic_qemu/testcase.yaml
```yaml
tests:
  ese5180.basic.qemu:
    platform_allow:
      - qemu_cortex_m3
    tags: qemu basic
    harness: ztest
```
